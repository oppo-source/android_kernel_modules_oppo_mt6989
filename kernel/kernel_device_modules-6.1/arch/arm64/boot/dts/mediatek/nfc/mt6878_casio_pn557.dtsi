/**********************************************************************************
* Copyright (c)  2008-2020  Guangdong oplus Mobile Comm Corp., Ltd
*
***********************************************************************************/
&odm {
       nfc_chipset:nfc_chipset {
       compatible = "oplus-nfc-chipset";
       chipset-24678 = "PN557";
       manifest = "/odm/etc/vintf/manifest/manifest_nfc_pn557.xml";
	};
};

&i2c3 {
       status = "okay";
       clock-frequency = <400000>;
       nq@28 {
               compatible = "nxp,pn553";
               reg = <0x28>;
               nxp,pn544-irq = <&pio 2 0x0>;
               nxp,pn544-ven = <&pio 40 0x0>;
               nxp,pn544-fw-dwnld = <&pio 38 0x0>;
               nxp,pn544-clkreq = <&pio 151 0x0>;
               interrupt-parent = <&pio>;
       };
};
