/**********************************************************************************
* Copyright (c)  2008-2020  Guangdong oplus Mobile Comm Corp., Ltd
*
***********************************************************************************/
&odm {
        nfc_chipset:nfc_chipset {
                compatible = "oplus-nfc-chipset";
                chipset-24678 = "THN31";
                manifest = "/odm/etc/vintf/manifest/manifest_nfc_thn31.xml";
        };
};

&i2c3 {
       status = "okay";
       clock-frequency = <400000>;

       tms_thn31@28 {
               compatible = "tms,nfc";
               reg = <0x28>;
               tms,irq-gpio = <&pio 2 0x0>;
               tms,ven-gpio = <&pio 40 0x0>;
               tms,download-gpio = <&pio 38 0x0>;
               //pn544-clkreq = <&pio 151 0x0>;
               interrupt-parent = <&pio>;
       };
};


