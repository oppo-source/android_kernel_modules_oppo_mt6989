## vendor/oplus/kernel/camera/flashlight/v4l2/Kconfig
```kconfig
config OPLUS_VIDEO_AW36515
	tristate "AW36515 dual flash driver support"
	depends on I2C && VIDEO_DEV && MEDIA_CONTROLLER
	depends on MEDIA_CAMERA_SUPPORT
	select REGMAP_I2C
	help
	  This is a driver for the AW36515 dual flash controllers. It controls
	  flash, torch LEDs.

	  Say Y here if you want a flashlight driver IC LM3644.
	  Select this only if your board has this IC.
	  Say M here if you want to compile this driver as a module.

config OPLUS_VIDEO_AW36515_OMEGAS2
	tristate "AW36515 dual flash driver support"
	depends on I2C && VIDEO_DEV && MEDIA_CONTROLLER
	depends on MEDIA_CAMERA_SUPPORT
	select REGMAP_I2C
	help
	  This is a driver for the AW36515_OMEGAS2 dual flash controllers. It controls
	  flash, torch LEDs.

	  Say Y here if you want a flashlight driver IC LM3644.
	  Select this only if your board has this IC.
	  Say M here if you want to compile this driver as a module.

config OPLUS_VIDEO_AW36515_OMEGAS3
	tristate "AW36515 dual flash driver support"
	depends on I2C && VIDEO_DEV && MEDIA_CONTROLLER
	depends on MEDIA_CAMERA_SUPPORT
	select REGMAP_I2C
	help
	  This is a driver for the AW36515_OMEGAS3 dual flash controllers. It controls
	  flash, torch LEDs.

	  Say Y here if you want a flashlight driver IC LM3644.
	  Select this only if your board has this IC.
	  Say M here if you want to compile this driver as a module.

config OPLUS_VIDEO_AW36410_CASIO
	tristate "AW36410 flash driver support"
	depends on I2C && VIDEO_DEV && MEDIA_CONTROLLER
	depends on MEDIA_CAMERA_SUPPORT
	select REGMAP_I2C
	help
	  This is a driver for the AW36410_CASIO dual flash controllers. It controls
	  flash, torch LEDs.

	  Say Y here if you want a flashlight driver IC AW36410_CASIO.
	  Select this only if your board has this IC.
	  Say M here if you want to compile this driver as a module.

config OPLUS_VIDEO_AW36515_MILKYWAYC1
	tristate "AW36515 dual flash driver support"
	depends on I2C && VIDEO_DEV && MEDIA_CONTROLLER
	depends on MEDIA_CAMERA_SUPPORT
	select REGMAP_I2C
	help
	  This is a driver for the AW36515_MILKYWAYC1 dual flash controllers. It controls
	  flash, torch LEDs.

	  Say Y here if you want a flashlight driver IC LM3644.
	  Select this only if your board has this IC.
	  Say M here if you want to compile this driver as a module.

config OPLUS_VIDEO_SY7806E_MILKYWAYC2
	tristate "AW36515 dual flash driver support"
	depends on I2C && VIDEO_DEV && MEDIA_CONTROLLER
	depends on MEDIA_CAMERA_SUPPORT
	select REGMAP_I2C
	help
	  This is a driver for the SY7806E_MILKYWAYC2 dual flash controllers. It controls
	  flash, torch LEDs.

	  Say Y here if you want a flashlight driver IC LM3644.
	  Select this only if your board has this IC.
	  Say M here if you want to compile this driver as a module.

config OPLUS_VIDEO_SY7806E_ALPHAH
	tristate "SY7806E dual flash driver support"
	depends on I2C && VIDEO_DEV && MEDIA_CONTROLLER
	depends on MEDIA_CAMERA_SUPPORT
	select REGMAP_I2C
	help
	  This is a driver for the SY7806E_ALPHAH dual flash controllers. It controls
	  flash, torch LEDs.

	  Say Y here if you want a flashlight driver IC ALPHAH.
	  Select this only if your board has this IC.
	  Say M here if you want to compile this driver as a module.

config OPLUS_VIDEO_AW36515_CASIOX
	tristate "AW36515 dual flash driver support"
	depends on I2C && VIDEO_DEV && MEDIA_CONTROLLER
	depends on MEDIA_CAMERA_SUPPORT
	select REGMAP_I2C
	help
	  This is a driver for the AW36515_CASIOX dual flash controllers. It controls
	  flash, torch LEDs.

	  Say Y here if you want a flashlight driver IC AW36515.
	  Select this only if your board has this IC.
	  Say M here if you want to compile this driver as a module.

config OPLUS_VIDEO_AW36515_2LED_CASIOX
	tristate "AW36515 dual flash driver support"
	depends on I2C && VIDEO_DEV && MEDIA_CONTROLLER
	depends on MEDIA_CAMERA_SUPPORT
	select REGMAP_I2C
	help
	  This is a driver for the AW36515_2LED_CASIOX dual flash controllers. It controls
	  flash, torch LEDs.

	  Say Y here if you want a flashlight driver IC AW36515.
	  Select this only if your board has this IC.
	  Say M here if you want to compile this driver as a module.

config OPLUS_VIDEO_AW36515_CAYMANA
	tristate "AW36515E flash driver support"
	depends on I2C && VIDEO_DEV && MEDIA_CONTROLLER
	depends on MEDIA_CAMERA_SUPPORT
	select REGMAP_I2C
	help
	  This is a driver for the AW36515_CAYMANA flash controllers. It controls
	  flash, torch LEDs.

	  Say Y here if you want a flashlight driver IC AW36515E.
	  Select this only if your board has this IC.
	  Say M here if you want to compile this driver as a module.

config OPLUS_VIDEO_AW36515_CAYMANB
	tristate "AW36515E flash driver support"
	depends on I2C && VIDEO_DEV && MEDIA_CONTROLLER
	depends on MEDIA_CAMERA_SUPPORT
	select REGMAP_I2C
	help
	  This is a driver for the AW36515_CAYMANB flash controllers. It controls
	  flash, torch LEDs.

	  Say Y here if you want a flashlight driver IC AW36515E.
	  Select this only if your board has this IC.
	  Say M here if you want to compile this driver as a module.
```
