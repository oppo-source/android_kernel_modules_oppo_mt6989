## kernel/kernel_device_modules-6.1/Kconfig.ext
```kconfig
# SPDX-License-Identifier: GPL-2.0

config DEVICE_MODULES_ALLOW_BUILTIN
	bool "allow builtin drivers into kernel image"
	help
	  All modules are default built as kernel modules.
	  Set DEVICE_MODULES_ALLOW_BUILTIN=y to build modules
	  into the kernel image.
	  If unsure, say N.

source "$(KCONFIG_EXT_PREFIX)drivers/memory/Kconfig"

source "$(KCONFIG_EXT_PREFIX)drivers/iio/adc/Kconfig"

source "$(KCONFIG_EXT_PREFIX)drivers/mfd/Kconfig"

source "$(KCONFIG_EXT_PREFIX)drivers/nvmem/Kconfig"

source "$(KCONFIG_EXT_PREFIX)drivers/dma/mediatek/Kconfig"

source "$(KCONFIG_EXT_PREFIX)drivers/ufs/Kconfig"

source "$(KCONFIG_EXT_PREFIX)drivers/char/Kconfig"

source "$(KCONFIG_EXT_PREFIX)drivers/clk/mediatek/Kconfig"

source "$(KCONFIG_EXT_PREFIX)drivers/clocksource/Kconfig"

source "$(KCONFIG_EXT_PREFIX)drivers/cpufreq/Kconfig"

source "$(KCONFIG_EXT_PREFIX)drivers/soc/mediatek/Kconfig"

source "$(KCONFIG_EXT_PREFIX)drivers/watchdog/Kconfig"

source "$(KCONFIG_EXT_PREFIX)drivers/dma-buf/heaps/Kconfig"

source "$(KCONFIG_EXT_PREFIX)drivers/regulator/Kconfig"

source "$(KCONFIG_EXT_PREFIX)drivers/leds/Kconfig"

source "$(KCONFIG_EXT_PREFIX)drivers/pinctrl/mediatek/Kconfig"

source "$(KCONFIG_EXT_PREFIX)drivers/power/supply/Kconfig"

source "$(KCONFIG_EXT_PREFIX)drivers/power/Kconfig"

source "$(KCONFIG_EXT_PREFIX)drivers/rtc/Kconfig"

source "$(KCONFIG_EXT_PREFIX)drivers/remoteproc/Kconfig"

source "$(KCONFIG_EXT_PREFIX)drivers/rpmsg/Kconfig"

source "$(KCONFIG_EXT_PREFIX)drivers/input/keyboard/Kconfig"

source "$(KCONFIG_EXT_PREFIX)drivers/phy/mediatek/Kconfig"

source "$(KCONFIG_EXT_PREFIX)drivers/thermal/mediatek/Kconfig"

source "$(KCONFIG_EXT_PREFIX)drivers/spmi/Kconfig"

source "$(KCONFIG_EXT_PREFIX)drivers/tty/serial/8250/Kconfig"

source "$(KCONFIG_EXT_PREFIX)drivers/reset/Kconfig"

source "$(KCONFIG_EXT_PREFIX)drivers/mailbox/Kconfig"

source "$(KCONFIG_EXT_PREFIX)drivers/interconnect/Kconfig"

source "$(KCONFIG_EXT_PREFIX)drivers/i2c/busses/Kconfig"

source "$(KCONFIG_EXT_PREFIX)drivers/pwm/Kconfig"

source "$(KCONFIG_EXT_PREFIX)drivers/spi/Kconfig"

source "$(KCONFIG_EXT_PREFIX)drivers/iommu/Kconfig"

source "$(KCONFIG_EXT_PREFIX)drivers/tee/Kconfig"

source "$(KCONFIG_EXT_PREFIX)drivers/mmc/host/Kconfig"

source "$(KCONFIG_EXT_PREFIX)drivers/gpu/drm/mediatek/Kconfig"

source "$(KCONFIG_EXT_PREFIX)drivers/input/touchscreen/Kconfig"

source "$(KCONFIG_EXT_PREFIX)drivers/gpu/drm/panel/Kconfig"

source "$(KCONFIG_EXT_PREFIX)drivers/gpu/mediatek/Kconfig"

source "$(KCONFIG_EXT_PREFIX)drivers/media/platform/Kconfig"

source "$(KCONFIG_EXT_PREFIX)drivers/usb/Kconfig"

source "$(KCONFIG_EXT_PREFIX)drivers/devfreq/Kconfig"

source "$(KCONFIG_EXT_PREFIX)drivers/misc/mediatek/Kconfig"

source "$(KCONFIG_EXT_PREFIX)sound/soc/codecs/Kconfig"

source "$(KCONFIG_EXT_PREFIX)sound/soc/mediatek/Kconfig"

source "$(KCONFIG_EXT_PREFIX)drivers/pci/controller/Kconfig"

source "$(KCONFIG_EXT_PREFIX)drivers/pinctrl/Kconfig"

source "$(KCONFIG_EXT_PREFIX)drivers/media/platform/mtk-isp/Kconfig"

source "$(KCONFIG_EXT_PREFIX)sound/soc/codecs/audio/Kconfig"

source "$(KCONFIG_EXT_PREFIX)drivers/soc/oplus/oplus_mm_fb/Kconfig"

source "$(KCONFIG_EXT_PREFIX)drivers/soc/oplus/boot/Kconfig"

source "$(KCONFIG_EXT_PREFIX)drivers/soc/oplus/boot/oplus_projectinfo/Kconfig"

source "$(KCONFIG_EXT_PREFIX)drivers/soc/oplus/boot/cmdline_parser/Kconfig"

source "$(KCONFIG_EXT_PREFIX)drivers/soc/oplus/device_info/Kconfig"

source "$(KCONFIG_EXT_PREFIX)kernel/oplus_cpu/Kconfig"

source "$(KCONFIG_EXT_PREFIX)drivers/soc/oplus/dft/common/olc/Kconfig"

source "$(KCONFIG_EXT_PREFIX)drivers/soc/oplus/dft/common/feedback/Kconfig"

source "$(KCONFIG_EXT_PREFIX)drivers/base/kernelFwUpdate/Kconfig"

source "$(KCONFIG_EXT_PREFIX)drivers/base/touchpanel_notify/Kconfig"

source "$(KCONFIG_EXT_PREFIX)drivers/misc/oplus/sim_detect/Kconfig"

source "$(KCONFIG_EXT_PREFIX)fs/f2fs/Kconfig"

source "$(KCONFIG_EXT_PREFIX)drivers/misc/mediatek/imgsensor/oplus_dfx/Kconfig"

source "$(KCONFIG_EXT_PREFIX)drivers/misc/oplus/vibrator/aw8697_haptic/Kconfig"

source "$(KCONFIG_EXT_PREFIX)drivers/misc/oplus/vibrator/si_haptic/Kconfig"

source "$(KCONFIG_EXT_PREFIX)drivers/oplus_inject/Kconfig"

source "$(KCONFIG_EXT_PREFIX)drivers/soc/oplus/storage/common/storage_log/Kconfig"

source "$(KCONFIG_EXT_PREFIX)drivers/soc/oplus/storage/common/oplus_uprobe/Kconfig"

source "$(KCONFIG_EXT_PREFIX)drivers/misc/oplus/oplus_gpio/Kconfig"

source "$(KCONFIG_EXT_PREFIX)drivers/base/magtransfer/Kconfig"
```

## kernel/kernel_device_modules-6.1/drivers/leds/aw21012/Kconfig
```kconfig
config AW_BREATH_ALGORITHM
	tristate "LED Support for AW210XX"
	depends on LEDS_CLASS && I2C
	help
	  this option enables support for the AW210XXRGB LED connected
	  through I2C. Say Y to enable support for the AW210XX LED
	  light automatically.

config AW_LAMP_INTERFACE
	tristate "LED Support for AW210XX"
	depends on LEDS_CLASS && I2C
	help
	  this option enables support for the AW210XXRGB LED connected
	  through I2C. Say Y to enable support for the AW210XX LED
	  light automatically.

config LEDS_AW21012
	tristate "LED Support for AW21012"
	depends on LEDS_CLASS && I2C
	help
	  this option enables support for the AW210XXRGB LED connected
	  through I2C. Say Y to enable support for the AW21012 LED
	  light automatically.
```

## kernel/kernel_device_modules-6.1/drivers/leds/aw21024/Kconfig
```kconfig
config AW_BREATH_ALGORITHM
	tristate "LED Support for AW21024"
	depends on LEDS_CLASS && I2C
	help
	  this option enables support for the AW21024RGB LED connected
	  through I2C. Say Y to enable support for the AW21024 LED
	  light automatically.

config AW_LAMP_INTERFACE
	tristate "LED Support for AW21024"
	depends on LEDS_CLASS && I2C
	help
	  this option enables support for the AW21024RGB LED connected
	  through I2C. Say Y to enable support for the AW21024 LED
	  light automatically.

config LEDS_AW21024
    tristate "LED Support for AW21024"
    depends on LEDS_CLASS && I2C
    help
        this option enables support for the AW21024 RGB LED connected
        through I2C. Say Y to enable support for the AW21024 LED
        light automatically.
```

## kernel/kernel_device_modules-6.1/drivers/leds/flash/Kconfig
```kconfig
config LEDS_MT6379
	tristate "Flash LED support for Mediatek MT6379 PMIC"
	depends on OF
	depends on V4L2_FLASH_LED_CLASS || !V4L2_FLASH_LED_CLASS
	depends on MFD_MT6379_I2C || MFD_MT6379_SPMI
	help
	  This option enables support Mediatek MT6379 flash LED controller.
	  MT6379 integrate charger, typec, dual BMS gauge, one general
	  Buck-Boost controller and three channels flash LED drivers. Each
	  channel support 25mA to 400mA for torch mode and 50mA to 1500mA for
	  strobe mode.

	  To compile this driver as a module, choose M here: the module
	  will be called leds-mt6379.
```

## kernel/kernel_device_modules-6.1/drivers/power/Kconfig
```kconfig
# SPDX-License-Identifier: GPL-2.0-only
#source "drivers/power/reset/Kconfig"
#source "drivers/power/supply/Kconfig"

menuconfig OPLUS_CHG_V2
	tristate "OPLUS charging V2 system"
	default n
	depends on I2C
	select REGMAP_I2C
	help
	  Say Y here to enable OPLUS charging V2 system support

config OPLUS_CHG
	tristate "OPLUS CHARGER KO module"
	default n
	help
	  Enables support for the oplus charging framework

config OPLUS_CHARGER
	bool "OPLUS_CHARGER"
	default n
	help
	  Set Yes to support OPLUS_CHARGER features
	  smart battery.
	  Set No to disable OPLUS_CHARGER features
	  smart battery.

config OPLUS_CHARGER_MTK
	bool "OPLUS charger on MTK"
	default n
	help
	  Say Yes here to declare charging system is on MTK
	  Say No here to declare charging system is not on MTK

config OPLUS_CHARGER_MTK_CHGIC
	bool "OPLUS_CHARGER_MTK_CHG_IC"
	default n
	help
	  Say Yes to use MTK platform charger ic
	  Say No to use extern charger ic

config OPLUS_CHARGER_MTK6985S
	bool "OPLUS_CHARGER_MTK6983S"
	default n
	help
	  Set yes to support OPLUS_CHARGER_MTK6985S features
	  smart battery.
	  Set No to disable OPLUS_CHARGER_MTK6985S features
	  smart battery.

config OPLUS_CHARGER_MTK6835T
	bool "OPLUS_CHARGER_MTK6835T"
	default n
	help
	  Set yes to support OPLUS_CHARGER_MTK6835T features
	  smart battery.
	  Set No to disable OPLUS_CHARGER_MTK6835T features
	  smart battery.

config OPLUS_CHARGER_MTKAGING
	bool "OPLUS_CHARGER_MTKAGING"
	default n
	help
	  Set yes to support amend mtk aging algo features
	  Set No to disable OPLUS_CHARGER_MTKAGING features

config OPLUS_HVDCP_SUPPORT
        bool "OPLUS_HVDCP_SUPPORT"
        default n
        help
          Set yes to support hvdcp.

config OPLUS_CHECK_CHARGERID_VOLT
	bool "OPLUS_CHECK_CHARGERID_VOLT"
	default n
	help
	  Set yes to support OPLUS_CHECK_CHARGERID_VOLT features
	  smart battery.
	  Set No to disable OPLUS_CHECK_CHARGERID_VOLT features
	  smart battery.

config OPLUS_4400MV_BATTERY_SUPPORT
	bool "OPLUS_CHECK_CHARGERID_VOLT"
	default n
	help
	  Set yes to support BATTERYID features
	  smart battery.
	  Set No to disable BATTERYID features
	  smart battery.

config OPLUS_CALL_MODE_SUPPORT
	bool "OPLUS call mode support"
	default n
	help
	  Say Y to enable support for the oplus call mode.

config OPLUS_CALL_MODE_SUPPORT
	bool "OPLUS call mode support"
	help
	  Say Y to enable support for the oplus call mode.

config OPLUS_SHIP_MODE_SUPPORT
	bool "OPLUS ship mode support"
	default n
	help
	  Say Y to include support

config OPLUS_SHORT_HW_CHECK
	bool "OPLUS batt HW SHORT"
	default n
	help
	  Say Y to include support

config OPLUS_SMART_CHARGER_SUPPORT
        bool "OPLUS Smart Charger support"
        default n
        help
          Say Y to include support

config OPLUS_CHIP_SOC_NODE
        bool "OPLUS chip soc node"
        help
          Say Y to include support

config OPLUS_SHORT_IC_CHECK
	bool "OPLUS batt short "
	help
	  Say Y here to declare charging system is on MTK

config OPLUS_CHG_DYNAMIC_CONFIG
	bool "OPLUS_CHG_DYNAMIC_CONFIG"
	default n
	help
	  Say Y to include support

config MTK_KERNEL_POWER_OFF_CHARGING
	bool "MTK kernel power off charging"
	default n
	help
	  yes : support KPOC feature, power off charging would running by
	  kernel and charging animation by kpoc service. no: not support KPOC
	  feature.
	  device won't enter charging mode if config is no.

config OPLUS_MTK_DRM_GKI_NOTIFY_CHG
	default n
	tristate "chg mtk gki notify"

config DISABLE_OPLUS_FUNCTION
	bool "CONFIG_DISABLE_OPLUS_FUNCTION"
	default n
	help
	  Say Y to include supports

config OPLUS_UFCS_CLASS
	tristate "oplus ufcs class"
	default n
	help
	  Say Y or M to enable oplus ufcs class

config OPLUS_CHARGER_MAXIM
	bool "encryption ic maxim support"
	help
	  Say Y here to declare encryption ic maxim support

config OPLUS_ENABLE_6375_RESET
	bool "enable 6375 reset"
	default n
	help
	  Say Y to enable subpmic reset

if OPLUS_CHG_V2
source "$(KCONFIG_EXT_PREFIX)drivers/power/oplus/v2/Kconfig"
endif
source "$(KCONFIG_EXT_PREFIX)drivers/power/oplus/v1/Kconfig"

source "$(KCONFIG_EXT_PREFIX)drivers/power/oplus/config/Kconfig"
source "$(KCONFIG_EXT_PREFIX)drivers/power/oplus/test-kit/Kconfig"
source "$(KCONFIG_EXT_PREFIX)drivers/power/oplus/wireless_pen/Kconfig"
```
