## kernel/kernel_device_modules-6.1/drivers/gpu/drm/bias/Kconfig
```kconfig
config DRM_BIAS_AW37501
    tristate "LCD Bias aw37501"
    help
      LCD Bias aw37501 for lcd driver nt36672c
```

## vendor/oplus/kernel/camera/regulator/Kconfig
```kconfig
config PMIC_WL2868C
	tristate "Fairchild WL2868C PMIC"
	depends on I2C && (OF || COMPILE_TEST)
	select REGMAP_I2C
	help
	  This driver supports Fairchild (ON Semiconductor) WL2868C
	  regulator. The regulator is a programmable power management IC
	  (PMIC), it is controlled by I2C and provides LDO outputs.

config PMIC_WL28681C1
	tristate "Fairchild WL28681C1 PMIC"
	depends on I2C && (OF || COMPILE_TEST)
	select REGMAP_I2C
	help
	  This driver supports Fairchild (ON Semiconductor) WL28681C1
	  regulator. The regulator is a programmable power management IC
	  (PMIC), it is controlled by I2C and provides LDO outputs.
```
